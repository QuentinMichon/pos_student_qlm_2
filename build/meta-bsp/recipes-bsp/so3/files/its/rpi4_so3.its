## build/meta-bsp/recipes-bsp/so3/files/its/rpi4_so3.its
```
/*
 * Copyright (C) 2014-2026 REDS Institute, HEIG-VD, Yverdon
 *
 * This program is free software; you can redistribute it and/or modify
 * it under the terms of the GNU General Public License version 2 as
 * published by the Free Software Foundation.
 *
 * This program is distributed in the hope that it will be useful,
 * but WITHOUT ANY WARRANTY; without even the implied warranty of
 * MERCHANTABILITY or FITNESS FOR A PARTICULAR PURPOSE.  See the
 * GNU General Public License for more details.
 *
 * You should have received a copy of the GNU General Public License
 * along with this program; if not, write to the Free Software
 * Foundation, Inc., 51 Franklin St, Fifth Floor, Boston, MA  02110-1301  USA
 *
 */

/dts-v1/;

/ {
	description = "Kernel and rootfs components for Raspberry Pi 4 (armv7) environment";

	images {

		/*
		 * 0x01008000 = memory base 0x01000000 + the arm32 0x8000 text
		 * offset (the 64-bit chain uses 0x01080000 / 0x80000 instead).
		 */
		so3 {
			description = "SO3 OS kernel";
			data = /incbin/("${IB_SO3_PATH}/so3/so3.bin");
			type = "kernel";
			arch = "arm";
			os = "linux";
			compression = "none";
			load = <0x01008000>;
			entry = <0x01008000>;
		};

		fdt {
			description = "Flattened Device Tree blob";
			data = /incbin/("${IB_SO3_PATH}/so3/dts/rpi4.dtb");
			type = "flat_dt";
			arch = "arm";
			compression = "none";
			load = <0x04a00000>;
		};

		ramfs {
			description = "SO3 environment minimal rootfs";
			data = /incbin/("${IB_ROOTFS_PATH}/rootfs.fat");
			type = "ramdisk";
			arch = "arm";
			os = "linux";
			compression = "none";
			load = <0x04c00000>;
		};

	};

	configurations {
		default = "so3";

		so3 {
			description = "SO3 on RPi4/32-bit";
			kernel = "so3";
			fdt = "fdt";
			ramdisk = "ramfs";
		};
	};

};
```
